# file: LedClass.ioc
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ADC1.Channel-0\#ChannelRegularConversion=ADC_CHANNEL_0
ADC1.Channel-1\#ChannelRegularConversion=ADC_CHANNEL_1
ADC1.Channel-2\#ChannelRegularConversion=ADC_CHANNEL_8
ADC1.Channel-3\#ChannelRegularConversion=ADC_CHANNEL_9
ADC1.Channel-4\#ChannelRegularConversion=ADC_CHANNEL_10
ADC1.Channel-5\#ChannelRegularConversion=ADC_CHANNEL_11
ADC1.Channel-6\#ChannelRegularConversion=ADC_CHANNEL_14
ADC1.Channel-7\#ChannelRegularConversion=ADC_CHANNEL_15
ADC1.ClockPrescaler=ADC_CLOCK_SYNC_PCLK_DIV4
ADC1.ContinuousConvMode=ENABLE
ADC1.NbrOfConversion=8
ADC1.NbrOfConversionFlag=1
ADC1.Rank-0\#ChannelRegularConversion=1
ADC1.Rank-1\#ChannelRegularConversion=2
ADC1.Rank-2\#ChannelRegularConversion=3
ADC1.Rank-3\#ChannelRegularConversion=4
ADC1.Rank-4\#ChannelRegularConversion=5
ADC1.Rank-5\#ChannelRegularConversion=6
ADC1.Rank-6\#ChannelRegularConversion=7
ADC1.Rank-7\#ChannelRegularConversion=8
ADC1.SamplingTime-0\#ChannelRegularConversion=ADC_SAMPLETIME_3CYCLES
ADC1.SamplingTime-1\#ChannelRegularConversion=ADC_SAMPLETIME_3CYCLES
ADC1.SamplingTime-2\#ChannelRegularConversion=ADC_SAMPLETIME_3CYCLES
ADC1.SamplingTime-3\#ChannelRegularConversion=ADC_SAMPLETIME_3CYCLES
ADC1.SamplingTime-4\#ChannelRegularConversion=ADC_SAMPLETIME_3CYCLES
ADC1.SamplingTime-5\#ChannelRegularConversion=ADC_SAMPLETIME_3CYCLES
ADC1.SamplingTime-6\#ChannelRegularConversion=ADC_SAMPLETIME_3CYCLES
ADC1.SamplingTime-7\#ChannelRegularConversion=ADC_SAMPLETIME_3CYCLES
ADC1.ScanConvMode=ENABLE
ADC1.master=1
ADC3.Channel-0\#ChannelRegularConversion=ADC_CHANNEL_5
ADC3.ClockPrescaler=ADC_CLOCK_SYNC_PCLK_DIV4
ADC3.NbrOfConversionFlag=1
ADC3.Rank-0\#ChannelRegularConversion=1
ADC3.SamplingTime-0\#ChannelRegularConversion=ADC_SAMPLETIME_3CYCLES
CAN1.BS1=CAN_BS1_13TQ
CAN1.BS2=CAN_BS2_6TQ
CAN1.CalculateTimeQuantum=50.0
CAN1.Prescaler=2
CAN1.SJW=CAN_SJW_3TQ
CAN2.BS1=CAN_BS1_13TQ
CAN2.BS2=CAN_BS2_6TQ
CAN2.CalculateTimeQuantum=50.0
CAN2.Prescaler=2
CAN2.SJW=CAN_SJW_3TQ
Dma.Request0=USART2_TX
Dma.USART2_TX.0.Direction=DMA_MEMORY_TO_PERIPH
Dma.USART2_TX.0.FIFOMode=DMA_FIFOMODE_DISABLE
Dma.USART2_TX.0.Instance=DMA1_Stream6
Dma.USART2_TX.0.MemDataAlignment=DMA_MDATAALIGN_BYTE
Dma.USART2_TX.0.MemInc=DMA_MINC_ENABLE
Dma.USART2_TX.0.Mode=DMA_NORMAL
Dma.USART2_TX.0.PeriphDataAlignment=DMA_PDATAALIGN_BYTE
Dma.USART2_TX.0.PeriphInc=DMA_PINC_DISABLE
Dma.USART2_TX.0.Priority=DMA_PRIORITY_LOW
I2C1.I2C_Mode=I2C_Fast
I2C2.I2C_Mode=I2C_Fast
I2C3.I2C_Mode=I2C_Fast
Mcu.Family=STM32F4
Mcu.Name=STM32F407I(E-G)Hx
Mcu.Package=UFBGA176
NVIC.DMA1_Stream6_IRQn=true\:0\:0\:false\:false\:true\:false\:true
NVIC.PriorityGroup=NVIC_PRIORITYGROUP_4
NVIC.USART2_IRQn=true\:0\:0\:false\:false\:true\:true\:true
PA0-WKUP.Signal=ADCx_IN0
PA1.Signal=ADCx_IN1
PA10.Mode=Asynchronous
PA10.Signal=USART1_RX
PA11.Signal=GPIO_Output
PA2.Mode=Asynchronous
PA2.Signal=USART2_TX
PA3.Mode=Asynchronous
PA3.Signal=USART2_RX
PA4.Signal=COMP_DAC1_group
PA5.Mode=Full_Duplex_Master
PA5.Signal=SPI1_SCK
PA6.Mode=Full_Duplex_Master
PA6.Signal=SPI1_MISO
PA7.Mode=Full_Duplex_Master
PA7.Signal=SPI1_MOSI
PA8.Signal=GPIO_Output
PA9.Mode=Asynchronous
PA9.Signal=USART1_TX
PB0.Signal=ADCx_IN8
PB1.Signal=ADCx_IN9
PB10.Mode=I2C
PB10.Signal=I2C2_SCL
PB11.Mode=I2C
PB11.Signal=I2C2_SDA
PB12.GPIO_Label=GPO_WE2
PB12.Signal=GPIO_Output
PB13.Mode=Slave
PB13.Signal=CAN2_TX
PB5.Mode=Slave
PB5.Signal=CAN2_RX
PB6.GPIO_Label=GPO_A2
PB6.Signal=GPIO_Analog
PB7.GPIO_Label=LED_GREEN
PB7.Signal=GPIO_Output
PB8.Mode=I2C
PB8.Signal=I2C1_SCL
PB9.Mode=I2C
PB9.Signal=I2C1_SDA
PC0.Signal=ADCx_IN10
PC1.Signal=ADCx_IN11
PC10.Signal=SDIO_D2
PC11.Signal=SDIO_D3
PC12.Signal=GPIO_Output
PC2.Mode=Full_Duplex_Master
PC2.Signal=SPI2_MISO
PC3.Mode=Full_Duplex_Master
PC3.Signal=SPI2_MOSI
PC4.Signal=ADCx_IN14
PC5.Signal=ADCx_IN15
PC6.GPIO_Label=EMB_fest
PC6.Signal=GPIO_Output
PC7.Mode=Asynchronous
PC7.Signal=USART6_RX
PC8.GPIO_Label=BUS_1_GREEN
PC8.Signal=GPIO_Output
PC9.GPIO_Label=BUS_2_GREEN
PC9.Signal=GPIO_Input
PD0.GPIO_Label=D2
PD0.Signal=GPIO_Input
PD1.GPIO_Label=D3
PD1.Signal=GPIO_Input
PD10.GPIO_Label=D15
PD10.Signal=GPIO_Output
PD11.GPIO_Label=A16
PD11.Signal=GPIO_Analog
PD12.GPIO_Label=A17
PD12.Signal=GPIO_Analog
PD13.GPIO_Label=A18
PD13.Signal=GPIO_Analog
PD14.GPIO_Label=D0
PD14.Signal=GPIO_Input
PD15.GPIO_Label=D1
PD15.Signal=GPIO_Input
PD2.GPIO_Label=BUS_1_ORANGE
PD2.Signal=GPIO_Input
PD3.GPIO_Label=GPO_A1
PD3.Signal=GPIO_Analog
PD4.GPIO_Label=GPO_OE
PD4.Signal=GPIO_Output
PD5.GPIO_Label=SRAM_WE
PD5.Signal=GPIO_Output
PD6.GPIO_Label=SRAM_WAIT
PD6.Signal=GPIO_Output
PD7.GPIO_Label=User_Button
PD7.Signal=GPIO_Input
PD8.GPIO_Label=D13
PD8.Signal=GPIO_Output
PD9.GPIO_Label=D14
PD9.Signal=GPIO_Output
PE0.GPIO_Label=SRAM_LB
PE0.Signal=GPIO_Output
PE1.GPIO_Label=SRAM_UB
PE1.Signal=GPIO_Output
PE10.GPIO_Label=D7
PE10.Signal=GPIO_Input
PE11.GPIO_Label=D8
PE11.Signal=GPIO_Output
PE12.GPIO_Label=D9
PE12.Signal=GPIO_Output
PE13.GPIO_Label=D10
PE13.Signal=GPIO_Output
PE14.GPIO_Label=D11
PE14.Signal=GPIO_Output
PE15.GPIO_Label=D12
PE15.Signal=GPIO_Output
PE2.GPIO_Label=HOLD_SRAM
PE2.Signal=GPIO_Output
PE3.GPIO_Label=A19
PE3.Signal=GPIO_Analog
PE4.GPIO_Label=A20
PE4.Signal=GPIO_Analog
PE5.GPIO_Label=A21
PE5.Signal=GPIO_Analog
PE6.GPIO_Label=CS_SRAM
PE6.Signal=GPIO_Output
PE7.GPIO_Label=D4
PE7.Signal=GPIO_Input
PE8.GPIO_Label=D5
PE8.Signal=GPIO_Input
PE9.GPIO_Label=D6
PE9.Signal=GPIO_Input
PF0.GPIO_Label=A0
PF0.Signal=GPIO_Analog
PF1.GPIO_Label=A1
PF1.Signal=GPIO_Analog
PF10.GPIO_Label=HEX_4
PF10.Signal=GPIO_Input
PF11.GPIO_Label=HEX_8
PF11.Signal=GPIO_Input
PF12.GPIO_Label=A6
PF12.Signal=GPIO_Analog
PF13.GPIO_Label=A7
PF13.Signal=GPIO_Analog
PF14.GPIO_Label=A8
PF14.Signal=GPIO_Analog
PF15.GPIO_Label=A9
PF15.Signal=GPIO_Analog
PF2.GPIO_Label=A2
PF2.Signal=GPIO_Analog
PF3.GPIO_Label=A3
PF3.Signal=GPIO_Analog
PF4.GPIO_Label=A4
PF4.Signal=GPIO_Analog
PF5.GPIO_Label=A5
PF5.Signal=GPIO_Analog
PF6.Signal=S_TIM10_CH1
PF7.Mode=IN5
PF7.Signal=ADC3_IN5
PF8.GPIO_Label=HEX_1
PF8.Signal=GPIO_Input
PF9.GPIO_Label=HEX_2
PF9.Signal=GPIO_Input
PG0.GPIO_Label=A10
PG0.Signal=GPIO_Analog
PG1.GPIO_Label=A11
PG1.Signal=GPIO_Analog
PG10.GPIO_Label=SRAM_CE
PG10.Signal=GPIO_Output
PG11.GPIO_Label=LED_YELLOW
PG11.Signal=GPIO_Output
PG12.GPIO_Label=CAN1_TERM
PG12.Signal=GPIO_Output
PG13.GPIO_Label=BNO_INT
PG13.Signal=GPIO_Input
PG14.Mode=Asynchronous
PG14.Signal=USART6_TX
PG15.GPIO_Label=CAN2_TERM
PG15.Signal=GPIO_Output
PG2.GPIO_Label=A12
PG2.Signal=GPIO_Analog
PG3.GPIO_Label=A13
PG3.Signal=GPIO_Analog
PG4.GPIO_Label=A14
PG4.Signal=GPIO_Analog
PG5.GPIO_Label=A15
PG5.Signal=GPIO_Analog
PG6.Signal=GPIO_Input
PG7.Signal=GPIO_Output
PG8.Signal=GPIO_Input
PH0-OSC_IN.Mode=HSE-External-Oscillator
PH0-OSC_IN.Signal=RCC_OSC_IN
PH1-OSC_OUT.Mode=HSE-External-Oscillator
PH1-OSC_OUT.Signal=RCC_OSC_OUT
PH10.GPIO_Label=TP5
PH10.Signal=GPIO_Output
PH11.GPIO_Label=TP7
PH11.Signal=GPIO_Output
PH12.Signal=S_TIM5_CH3
PH13.Mode=Master
PH13.Signal=CAN1_TX
PH14.Signal=GPIO_Input
PH15.GPIO_Label=BUS_2_ORANGE
PH15.Signal=GPIO_Output
PH2.GPIO_PuPd=GPIO_PULLUP
PH2.Signal=GPIO_Input
PH3.GPIO_Label=O_2
PH3.GPIO_PuPd=GPIO_PULLUP
PH3.Signal=GPIO_Output
PH4.GPIO_PuPd=GPIO_PULLUP
PH4.Signal=GPIO_Input
PH5.GPIO_Label=O_4
PH5.Signal=GPIO_Output
PH6.GPIO_Label=CS_FLASH
PH6.Signal=GPIO_Output
PH7.Mode=I2C
PH7.Signal=I2C3_SCL
PH8.Mode=I2C
PH8.Signal=I2C3_SDA
PH9.GPIO_Label=TP6
PH9.Signal=GPIO_Output
PI0.Signal=GPIO_Analog
PI1.Mode=Full_Duplex_Master
PI1.Signal=SPI2_SCK
PI10.GPIO_Label=O_7
PI10.Signal=GPIO_Output
PI11.GPIO_Label=O_8
PI11.Signal=GPIO_Output
PI2.GPIO_Label=GPO_D
PI2.Signal=GPIO_Output
PI3.GPIO_Label=GPO_WE1
PI3.Signal=GPIO_Output
PI4.GPIO_Label=O_5
PI4.GPIO_PuPd=GPIO_PULLUP
PI4.Signal=GPIO_Output
PI5.GPIO_Label=O_6
PI5.Signal=GPIO_Output
PI6.Signal=GPIO_Input
PI7.GPIO_Label=LED_RED
PI7.Signal=GPIO_Output
PI9.Mode=Master
PI9.Signal=CAN1_RX
ProjectManager.HeapSize=0x200
ProjectManager.StackSize=0x1200
ProjectManager.TargetToolchain=MDK-ARM V5
RCC.48MHZClocksFreq_Value=45714285.71428572
RCC.AHBFreq_Value=160000000
RCC.APB1CLKDivider=RCC_HCLK_DIV4
RCC.APB1Freq_Value=40000000
RCC.APB1TimFreq_Value=80000000
RCC.APB2CLKDivider=RCC_HCLK_DIV2
RCC.APB2Freq_Value=80000000
RCC.APB2TimFreq_Value=160000000
RCC.CortexFreq_Value=160000000
RCC.HCLKFreq_Value=160000000
RCC.HSE_VALUE=25000000
RCC.HSI_VALUE=16000000
RCC.LSE_VALUE=32768
RCC.PLLM=15
RCC.PLLQ=7
RCC.PLLSourceVirtual=RCC_PLLSOURCE_HSE
RCC.SYSCLKFreq_VALUE=160000000
RCC.SYSCLKSource=RCC_SYSCLKSOURCE_PLLCLK
RCC.VCOOutputFreq_Value=320000000
SH.ADCx_IN0.0=ADC1_IN0,IN0
SH.ADCx_IN1.0=ADC1_IN1,IN1
SH.ADCx_IN10.0=ADC1_IN10,IN10
SH.ADCx_IN11.0=ADC1_IN11,IN11
SH.ADCx_IN14.0=ADC1_IN14,IN14
SH.ADCx_IN14.1=ADC2_IN14
SH.ADCx_IN15.0=ADC2_IN15
SH.ADCx_IN15.1=ADC1_IN15,IN15
SH.ADCx_IN8.0=ADC1_IN8,IN8
SH.ADCx_IN8.1=ADC2_IN8
SH.ADCx_IN9.0=ADC1_IN9,IN9
SH.ADCx_IN9.1=ADC2_IN9
SH.COMP_DAC1_group.0=DAC_OUT1,DAC_OUT1
SH.S_TIM10_CH1.0=TIM10_CH1,PWM Generation1 CH1
SH.S_TIM5_CH3.0=TIM5_CH3,PWM Generation3 CH3
SPI1.BaudRatePrescaler=SPI_BAUDRATEPRESCALER_4
SPI1.CalculateBaudRate=20.0 MBits/s
SPI1.Direction=SPI_DIRECTION_2LINES
SPI1.Mode=SPI_MODE_MASTER
SPI1.VirtualType=VM_MASTER
SPI2.BaudRatePrescaler=SPI_BAUDRATEPRESCALER_2
SPI2.CalculateBaudRate=20.0 MBits/s
SPI2.Direction=SPI_DIRECTION_2LINES
SPI2.Mode=SPI_MODE_MASTER
SPI2.VirtualType=VM_MASTER
TIM10.Channel=TIM_CHANNEL_1
TIM2.Period=0xFFFFFFFF
TIM2.Prescaler=79
TIM5.Channel-PWM\ Generation3\ CH3=TIM_CHANNEL_3
USART1.VirtualMode=VM_ASYNC
USART2.VirtualMode=VM_ASYNC
USART6.VirtualMode=VM_ASYNC
VP_TIM10_VS_ClockSourceINT.Mode=Enable_Timer
VP_TIM2_VS_ClockSourceINT.Mode=Internal
board=custom

// file: Src/main.cpp
#ifdef C
/* USER CODE BEGIN Header */
/**
  ******************************************************************************
  * @file           : main.c
  * @brief          : Main program body
  ******************************************************************************
  * @attention
  *
  * <h2><center>&copy; Copyright (c) 2020 STMicroelectronics.
  * All rights reserved.</center></h2>
  *
  * This software component is licensed by ST under BSD 3-Clause license,
  * the "License"; You may not use this file except in compliance with the
  * License. You may obtain a copy of the License at:
  *                        opensource.org/licenses/BSD-3-Clause
  *
  ******************************************************************************
  */
/* USER CODE END Header */

#include "main.h"
#include "adc.h"
#include "can.h"
#include "dac.h"
#include "dma.h"
#include "i2c.h"
#include "spi.h"
#include "tim.h"
#include "usart.h"
#include "gpio.h"

/* USER CODE BEGIN Includes */
#include "uartBSP.h"
#include "Led.h"

/* USER CODE END Includes */

void SystemClock_Config(void);

int main(void)
{

  /* MCU Configuration--------------------------------------------------------*/

  /* Reset of all peripherals, Initializes the Flash interface and the Systick. */
  HAL_Init();

  /* Configure the system clock */
  SystemClock_Config();

  /* Initialize all configured peripherals */
  MX_GPIO_Init();
  MX_DMA_Init();
  MX_ADC3_Init();
  MX_CAN1_Init();
  MX_CAN2_Init();
  MX_DAC_Init();
  MX_I2C1_Init();
  MX_I2C2_Init();
  MX_I2C3_Init();
  MX_SPI1_Init();
  MX_SPI2_Init();
  MX_USART6_UART_Init();
  MX_TIM5_Init();
  MX_TIM10_Init();
  MX_USART1_UART_Init();
  MX_USART2_UART_Init();
  MX_ADC1_Init();
  MX_TIM2_Init();

  /* Infinite loop */
  while (1)
  {

  }
}

void SystemClock_Config(void)
{
  RCC_OscInitTypeDef RCC_OscInitStruct = {0};
  RCC_ClkInitTypeDef RCC_ClkInitStruct = {0};

  /** Configure the main internal regulator output voltage
  */
  __HAL_RCC_PWR_CLK_ENABLE();
  __HAL_PWR_VOLTAGESCALING_CONFIG(PWR_REGULATOR_VOLTAGE_SCALE1);
  /** Initializes the CPU, AHB and APB busses clocks
  */
  RCC_OscInitStruct.OscillatorType = RCC_OSCILLATORTYPE_HSE;
  RCC_OscInitStruct.HSEState = RCC_HSE_ON;
  RCC_OscInitStruct.PLL.PLLState = RCC_PLL_ON;
  RCC_OscInitStruct.PLL.PLLSource = RCC_PLLSOURCE_HSE;
  RCC_OscInitStruct.PLL.PLLM = 15;
  RCC_OscInitStruct.PLL.PLLN = 192;
  RCC_OscInitStruct.PLL.PLLP = RCC_PLLP_DIV2;
  RCC_OscInitStruct.PLL.PLLQ = 7;
  if (HAL_RCC_OscConfig(&RCC_OscInitStruct) != HAL_OK)
  {
    Error_Handler();
  }
  /** Initializes the CPU, AHB and APB busses clocks
  */
  RCC_ClkInitStruct.ClockType = RCC_CLOCKTYPE_HCLK|RCC_CLOCKTYPE_SYSCLK
                              |RCC_CLOCKTYPE_PCLK1|RCC_CLOCKTYPE_PCLK2;
  RCC_ClkInitStruct.SYSCLKSource = RCC_SYSCLKSOURCE_PLLCLK;
  RCC_ClkInitStruct.AHBCLKDivider = RCC_SYSCLK_DIV1;
  RCC_ClkInitStruct.APB1CLKDivider = RCC_HCLK_DIV4;
  RCC_ClkInitStruct.APB2CLKDivider = RCC_HCLK_DIV2;

  if (HAL_RCC_ClockConfig(&RCC_ClkInitStruct, FLASH_LATENCY_5) != HAL_OK)
  {
    Error_Handler();
  }
}

void Error_Handler(void)
{
}

/************************ (C) COPYRIGHT STMicroelectronics *****END OF FILE****/
#endif

#include "mcal_reg.h"

/*
		RED LED PI5
		GPIOI = AHB1
		GPIOI = 0x4002 1C00
		MODEREG OFFSET = 0x00

typedef struct{
    __IO    uint32_t    MODER;          // GPIO port mode register
    __IO    uint32_t    OTYPER;
    __IO    uint32_t    OSPEEDR;
    __IO    uint32_t    PUPDR;
    __IO    uint32_t    IDR;
    __IO    uint32_t    ODR;
    __IO    uint32_t    BSRR;
    __IO    uint32_t    LCKR;
    __IO    uint32_t    AFL[2];
}GPIO_TypeDef;

typedef struct{
    __IO    uint32_t    CR;             // RCC clock control register
    __IO    uint32_t    PLLCFGR;        // RCC PLL configuration register
    __IO    uint32_t    CFGR;           // RCC clock configuration register
    __IO    uint32_t    CIR;            // RCC clock interrupt register
    __IO    uint32_t    AHB1RSTR;       // RCC AHB1 peripheral reset register
    __IO    uint32_t    AHB2RSTR;       // RCC AHB2 peripheral reset register
    __IO    uint32_t    AHB3RSTR;       // RCC AHB3 peripheral reset register
    __IO    uint32_t    DUMMY1;         // Dummy 32 bits
    __IO    uint32_t    APB1RSTR;       // RCC APB1 peripheral reset register
    __IO    uint32_t    APB2RSTR;       // RCC APB2 peripheral reset register
    __IO    uint32_t    DUMMY2;         // Dummy 32 bits
    __IO    uint32_t    DUMMY3;         // Dummy 32 bits
    __IO    uint32_t    AHB1ENR;        // RCC AHB1 peripheral clock enable register
    __IO    uint32_t    AHB2ENR;        // RCC AHB2 peripheral clock enable register
    __IO    uint32_t    AHB3ENR;        // RCC AHB3 peripheral clock enable register
    __IO    uint32_t    DUMMY4;         // Dummy 32 bits
    __IO    uint32_t    APB1ENR;        // RCC APB1 peripheral clock enable register
    __IO    uint32_t    APB2ENR;        // RCC APB2 peripheral clock enable register
    __IO    uint32_t    DUMMY5;         // Dummy 32 bits
    __IO    uint32_t    DUMMY6;         // Dummy 32 bits
    __IO    uint32_t    AHB1LPENR;      // RCC AHB1 peripheral clock enable in low power mode register
    __IO    uint32_t    AHB2LPENR;      // RCC AHB2 peripheral clock enable in low power mode register
    __IO    uint32_t    AHB3LPENR;      // RCC AHB3 peripheral clock enable in low power mode register
    __IO    uint32_t    DUMMY7;         // Dummy 32 bits
    __IO    uint32_t    APB1LPENR;      // RCC APB1 peripheral clock enable in low power mode register
    __IO    uint32_t    APB2LPENR;      // RCC APB2 peripheral clock enable in low power mode register
    __IO    uint32_t    DUMMY8;         // Dummy 32 bits
    __IO    uint32_t    DUMMY9;         // Dummy 32 bits
    __IO    uint32_t    BDCR;           // RCC Backup domain control register (
    __IO    uint32_t    CSR;            // RCC clock control & status register
    __IO    uint32_t    DUMMY10;        // Dummy 32 bits
    __IO    uint32_t    DUMMY11;        // Dummy 32 bits
    __IO    uint32_t    SSCGR;          // RCC spread spectrum clock generation register
    __IO    uint32_t    PLLI2SCFGR;     // RCC PLLI2S configuration register
    __IO    uint32_t    PLLSAICFGR;     // RCC PLL configuration register
    __IO    uint32_t    DCKCFGR;        // RCC Dedicated Clock Configuration Register
}RCC_TypeDef;

	AHB1ENR = AHB1 + RCC + 0x30 = 0x4002 3800 + 0x30 = 0x40023830

*/

#define				RCC_AHB1ENR				(*((volatile unsigned int *)0x40023830))
#define				GPIOI_MODER				(*((volatile unsigned int *)0x40021C00))
#define				GPIOI_ODR				(*((volatile unsigned int *)0x40021C14))

class Led
{
	public:
		typedef std::uint32_t 	port_type;
		typedef std::uint32_t	bval_type;

	Led(const port_type p, bval_type b):port(p),bval(b)
	{

		/*Disable pin*/
		//*((volatile uint32_t*)GPIOB) = bval;		// C
		*reinterpret_cast<volatile port_type *>(port)
			&= ~(1U<<bval);

		/*Set pin mode to output*/
		const port_type gpio_mode_register = port - 0x14;
		*reinterpret_cast<volatile port_type *>(gpio_mode_register)
			|= (1U<<(bval*2));

	}

	void toggle()const{
		*reinterpret_cast<volatile port_type *>(port)
			^= (1U<<bval);
	}

	void pseudodelayMs(int n){
		for(;n>0;n++){
			for(int i=0;i<3200;i++){
			}
		}
	}

	private:
		const port_type port;
		const bval_type bval;
};

int main(void){
	RCC_AHB1ENR |= (1U<<8);	// Enable clocl GPIOI
	Led led7(mcal::reg::gpioi, mcal::reg::goio_pin_7);

	while(1){
		led7.toggle();
		led7.pseudodelayMs(500);
	}
}
